## components/lwdt/drivers/i2c/Kconfig
```kconfig
menu "I2C"
    config DRVFX_I2C_IDF
        bool "Enable ESP-IDF I2C controller driver"
endmenu
```

## components/lwdt/drivers/rtc/Kconfig
```kconfig
menu "RTC (Real-Time Clock)"
    choice
        prompt "RTC device"
        default DRIVER_RTC_NONE

        config DRIVER_RTC_NONE
            bool "No RTC"

        config DRIVER_RTC_IDF
            bool "SoC internal RTC"

        config DRIVER_RTC_DS1302
            bool "DS1302"

        config DRIVER_RTC_PCF8563
            bool "PCF8563"
            depends on DRVFX_I2C_IDF
    endchoice

    config DRIVER_RTC_DS1302_CE_GPIO
        int "DS1302 CE GPIO number"
        depends on DRIVER_RTC_DS1302

    config DRIVER_RTC_DS1302_IO_GPIO
        int "DS1302 I/O GPIO number"
        depends on DRIVER_RTC_DS1302

    config DRIVER_RTC_DS1302_SCLK_GPIO
        int "DS1302 SCLK GPIO number"
        depends on DRIVER_RTC_DS1302

    config DRIVER_RTC_DS1302_RST_GPIO
        int "DS1302 RST GPIO number"
        depends on DRIVER_RTC_DS1302

endmenu
```

## components/lwdt/drivers/spi/Kconfig
```kconfig
menu "SPI"
    config DRVFX_SPI_IDF
        bool "Enable ESP-IDF SPI controller driver"
endmenu
```

## esp-idf-example/main/Kconfig.projbuild
```kconfig
menu "Example Configuration"

    orsource "$IDF_PATH/examples/common_components/env_caps/$IDF_TARGET/Kconfig.env_caps"

    choice BLINK_LED
        prompt "Blink LED type"
        default BLINK_LED_GPIO
        help
            Select the LED type. A normal level controlled LED.
            The default selection is based on the Espressif DevKit boards.
            You can change the default selection according to your board.

        config BLINK_LED_GPIO
            bool "GPIO"
    endchoice

    config BLINK_GPIO
        int "Blink GPIO number"
        range ENV_GPIO_RANGE_MIN ENV_GPIO_OUT_RANGE_MAX
        default 8
        help
            GPIO number (IOxx) to blink on and off the LED.
            Some GPIOs are used for other purposes (flash connections, etc.) and cannot be used to blink.

    config BLINK_PERIOD
        int "Blink period in ms"
        range 10 3600000
        default 1000
        help
            Define the blinking period in milliseconds.

endmenu
```
